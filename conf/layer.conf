## conf/layer.conf
```bitbake
# We have a conf and classes directory, add to BBPATH
BBPATH .= ":${LAYERDIR}"

# We have a packages directory, add to BBFILES
BBFILES += "${LAYERDIR}/recipes-*/*/*.bb \
            ${LAYERDIR}/recipes-*/*/*.bbappend"

BBFILE_COLLECTIONS += "variscite-community"
BBFILE_PATTERN_variscite-community := "^${LAYERDIR}/"
BBFILE_PRIORITY_variscite-community = "5"

LAYERDEPENDS_variscite-community = "core fsl-arm"
```

## conf/machine/include/imx6varsom-common.inc
```bitbake
# Provides the i.MX6 SABRE SD common settings

require conf/machine/include/var-imx-base.inc
require conf/machine/include/tune-cortexa9.inc

SERIAL_CONSOLE = "115200 ttymxc0"

MACHINE_FIRMWARE_append_mx6 = " linux-firmware-wl12xx"

MACHINE_FEATURES += " pci bluetooth touchscreen wifi"

MACHINE_EXTRA_RRECOMMENDS += "udev-udisks-rules-variscite"
```

## conf/machine/include/var-1gb-ubi.inc
```bitbake
#
# UBIFS for Variscite NAND 1.0 GB
#
UBI_ROOT_FS_NAME = "[rootfs]"
UBI_VOLNAME  = "rootfs"
MKUBIFS_ARGS = " -m 4096 -e 516096 -c 1895 -F "
UBINIZE_ARGS = " -m 4096 -p 512KiB -s 4096 -O 4096 "
#
```

## conf/machine/include/var-4gb-ubi.inc
```bitbake
#
# UBIFS for Variscite NAND 4.0 GB MT29F32G08AFACAWP
#
UBI_ROOT_FS_NAME = "[rootfs]"
UBI_VOLNAME  = "rootfs"
MKUBIFS_ARGS = " -m 4096 -e 504KiB -c 7855 -F "
UBINIZE_ARGS = " -m 4096 -p 512KiB -s 4096 -O 4096 "
#
```

## conf/machine/include/var-imx-base.inc
```bitbake
# Provides the variscite i.MX common settings

include conf/machine/include/imx-base.inc

IMAGE_CLASSES_remove = "image_types_fsl"
IMAGE_CLASSES += "image_types_var"

PREFERRED_PROVIDER_virtual/kernel = "linux-variscite"
PREFERRED_PROVIDER_virtual/bootloader = "u-boot-variscite-imx6"
PREFERRED_PROVIDER_u-boot = "u-boot-variscite-imx6"

SPL_BINARY = "SPL"
UBOOT_MAKE_TARGET = "all"
UBOOT_SUFFIX = "img"

UBOOT_CONFIG ??= "sd"
#UBOOT_CONFIG ??= "nand"

UBOOT_CONFIG[sd] = "mx6var_som_sd_config,sdcard"
UBOOT_CONFIG[nand] = "mx6var_som_nand_config,ubifs"

IMAGE_FSTYPES = "ubi sdcard"

#
# UBIFS for Variscite NAND 0.5 GB
#
#UBI_ROOT_FS_NAME = "[rootfs]"
#UBI_VOLNAME  = "rootfs"
#MKUBIFS_ARGS = " -m 2048 -e 124KiB -c 3965 -F "
#UBINIZE_ARGS = " -m 2048 -p 128KiB -s 2048 -O 2048 "
#
#
# UBIFS for Variscite NAND 1.0 GB
#
#UBI_ROOT_FS_NAME = "[rootfs]"
#UBI_VOLNAME  = "rootfs"
#MKUBIFS_ARGS = " -m 4096 -e 516096 -c 1895 "
#UBINIZE_ARGS = " -m 4096 -p 512KiB -s 4096 -O 4096 "
#
#
# UBIFS for Variscite NAND 2.0 GB
#
#UBI_ROOT_FS_NAME = "[rootfs]"
#UBI_VOLNAME  = "rootfs"
#MKUBIFS_ARGS = " -m 2048 -e 124KiB -c 15800 "
#UBINIZE_ARGS = " -m 2048 -p 128KiB -s 2048 -O 2048 "
#
#
# UBIFS for Variscite NAND 4.0 GB MT29F32G08AFACAWP
#
#UBI_ROOT_FS_NAME = "[rootfs]"
#UBI_VOLNAME  = "rootfs"
#MKUBIFS_ARGS = " -m 4096 -e 504KiB -c 7855 -F "
#UBINIZE_ARGS = " -m 4096 -p 512KiB -s 4096 -O 4096 "
#

EXTRA_IMAGEDEPENDS = "u-boot"

KERNEL_IMAGETYPE = "uImage"
```

## conf/machine/varsomimx6dl.conf
```bitbake
#@TYPE: Machine
#@NAME: Freescale i.MX6DL VAR-SOM-MX6
#@SOC: i.MX6DL
#@DESCRIPTION: Machine configuration for Freescale i.MX6DL VAR-SOM-MX6

require conf/machine/include/imx6varsom-common.inc
include conf/machine/include/var-512mb-ubi.inc

SOC_FAMILY = "mx6:mx6dl"

KERNEL_DEVICETREE = "imx6q-var-som.dtb imx6q-var-som-ldo.dtb imx6dl-var-som.dtb imx6sl-var-som.dtb"
```

## conf/machine/varsomimx6q.conf
```bitbake
#@TYPE: Machine
#@NAME: Variscite i.MX6Q VAR-SOM-MX6
#@SOC: i.MX6Q
#@DESCRIPTION: Machine configuration for Variscite i.MX6Q VAR-SOM-MX6

require conf/machine/include/imx6varsom-common.inc
include conf/machine/include/var-512mb-ubi.inc

SOC_FAMILY = "mx6:mx6q"

KERNEL_DEVICETREE = "imx6q-var-som.dtb imx6q-var-som-ldo.dtb imx6dl-var-som.dtb imx6sl-var-som.dtb"
```

## conf/machine/varsomimx6q2.conf
```bitbake
#@TYPE: Machine
#@NAME: Variscite i.MX6Q VAR-SOM-MX6
#@SOC: i.MX6Q
#@DESCRIPTION: Machine configuration for Variscite i.MX6Q VAR-SOM-MX6

require conf/machine/include/imx6varsom-common.inc
include conf/machine/include/var-4gb-ubi.inc

SOC_FAMILY = "mx6:mx6q"

KERNEL_DEVICETREE = "imx6q-var-som.dtb imx6q-var-som-ldo.dtb imx6dl-var-som.dtb imx6sl-var-som.dtb"

UBOOT_CONFIG ??= "sd"
#UBOOT_CONFIG ??= "nand"
#
#UBOOT_CONFIG[sd] = "vsmq_10m10g_sd_config,sdcard"
#UBOOT_CONFIG[nand] = "vsmq_10m10g_nand_config,ubifs"
#
#0.5GB DRAM Dual 
#UBOOT_CONFIG[sd] = "vsmd_10m05g_sd_config,sdcard"
#UBOOT_CONFIG[nand] = "vsmd_10m05g_nand_config,ubifs"
#
#2GB DRAM Quad 
UBOOT_CONFIG[sd] = "vsmq_12m20g_sd_config,sdcard"
UBOOT_CONFIG[nand] = "vsmq_12m20g_nand_config,ubifs"
```

## conf/machine/varsomimx6solo.conf
```bitbake
#@TYPE: Machine
#@NAME: Variscite i.MX6Solo SOM Support
#@SOC: i.MX6Q
#@DESCRIPTION: Machine configuration for Freescale i.MX6Solo on the VAR-MX6-SOM board

require conf/machine/include/imx6varsom-common.inc
include conf/machine/include/var-512mb-ubi.inc

SOC_FAMILY = "mx6:mx6s"

KERNEL_DEVICETREE = "imx6q-var-som.dtb imx6q-var-som-ldo.dtb imx6dl-var-som.dtb imx6sl-var-som.dtb"
```

## recipes-kernel/linux/linux-variscite_3.10.17/defconfig
```kconfig
#TI add for WL8
CONFIG_WLAN=y
CONFIG_CRYPTO_ARC4=y
CONFIG_CRYPTO_ECB=y
CONFIG_CRYPTO_AES=y
CONFIG_CRYPTO_MICHAEL_MIC=y
CONFIG_REGULATOR_FIXED_VOLTAGE=y
CONFIG_CRC7=y
CONFIG_NETFILTER=y
CONFIG_NETFILTER_ADVANCED=y
CONFIG_NF_CONNTRACK=y
CONFIG_NETFILTER_XTABLES=y
CONFIG_NF_DEFRAG_IPV4=y
CONFIG_NF_CONNTRACK_IPV4=y
CONFIG_NF_CONNTRACK_PROC_COMPAT=y
CONFIG_IP_NF_IPTABLES=y
CONFIG_IP_NF_FILTER=y
CONFIG_IP_NF_TARGET_LOG=y
CONFIG_NF_NAT=y
CONFIG_NF_NAT_NEEDED=y
CONFIG_IP_NF_TARGET_MASQUERADE=y
CONFIG_INPUT_UINPUT=y
CONFIG_CFG80211=n
CONFIG_MAC80211=n
CONFIG_AVERAGE=y

CONFIG_PROC_DEVICETREE=y
# enable dynamic debug for wl8
CONFIG_DYNAMIC_DEBUG=y
```
